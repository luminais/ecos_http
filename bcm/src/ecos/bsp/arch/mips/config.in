## bcm/src/ecos/bsp/arch/mips/config.in
```kconfig
#
#	$Id: config.in,v 1.1 2010-08-05 08:12:21 Exp $
#

mainmenu_name 'Broadcom eCos Platform Kernel Configuration'

mainmenu_option next_comment
comment 'BSP Library (CPU) Select'
	bool 'Support for Broadcom MIPS-based boards' CONFIG_MIPS_BRCM
	if [ "$CONFIG_MIPS_BRCM" = "y" ]; then
		bool 'Support Broadcom BCM947XX' CONFIG_BCM947XX
	fi
	string 'eCos Kernel Config File' CONFIG_ECC
endmenu

mainmenu_option next_comment
comment 'Hardware Configuration'
	comment 'Watchdog Timer Settings'
	bool 'Support Watchdog' CONFIG_WATCHDOG n
	if [ "$CONFIG_WATCHDOG" = "y" ]; then
		int '  Watchdog Timer Interval (seconds)' CONFIG_WATCHDOG_INTERVAL 15
	fi
endmenu

mainmenu_option next_comment
comment 'Software Module Options'
	comment 'VLAN'
	bool '  Support 802.1Q VLAN' CONFIG_VLAN

	comment 'Bridge'
	bool '  Support Bridge' CONFIG_BRIDGE
	int '  Number of bridges' CONFIG_NUM_BRIDGES

	comment 'PPP protocol stack'
	int '  Maximum PPP sessions' CONFIG_PPP_NUM_SESSIONS 1

	comment 'NAT options'
	int '  Maximum NAT links' CONFIG_NAT_LINKS 4096
endmenu

mainmenu_option next_comment
comment 'Device Drivers Options'
	comment '10/100/1000 Ethernet support'
	bool '  BCM47xx support' CONFIG_ET_47XX
	bool '  BCM57xx Gigabit Ethernet support' CONFIG_BCM57XX

	comment '802.11 Wireless support'
	bool '  BCM43xx 802.11 Wireless support Support Wireless' CONFIG_WL
	if [ "$CONFIG_WL" = "y" ]; then
		choice '    Wireless feature variant' \
		  "ap CONFIG_WL_USE_AP \
		   sta CONFIG_WL_USE_STA \
		   apsta CONFIG_WL_USE_APSTA"
		string '   Config file for basic AP variant' \
			   CONFIG_WL_AP wlconfig_ecos_router_ap
		string '   Config file for basic STA variant' \
			   CONFIG_WL_STA wlconfig_ecos_router_sta
		string '   Config file for basic APSTA variant' \
			   CONFIG_WL_APSTA wlconfig_ecos_router_apsta
	fi
endmenu
```

## rtk/boards/rtl8196e/config.in
```kconfig
menu "System Configuration"
 
config RTL_8196E
        bool "96E GW"
        help
          This enables support for Realtek RTL8196E demo board

config WATCHDOG
        bool "WatchDog Support"
 
config  MIPS16
        bool "Mips16 Support"
choice
prompt "Selected RAM_SIZE"
default RAM_SIZE_8M

config RAM_SIZE_64M
	bool "64M"

config RAM_SIZE_32M
	bool "32M"

config RAM_SIZE_16M
	bool "16M"

config RAM_SIZE_8M
	bool "8M"

config RAM_SIZE_4M
	bool "4M"
endchoice

endmenu
```

## rtk/boards/rtl8196eu/config.in
```kconfig
menu "System Configuration"
 
config RTL_8196E
        bool "96E GW"
        help
          This enables support for Realtek RTL8196E demo board

config RTL_ULINKER
        bool "96E ULINKER"
        help
          This enables support for RTL8196EU

config WATCHDOG
        bool "WatchDog Support"
 
config  MIPS16
        bool "Mips16 Support"
choice
prompt "Selected RAM_SIZE"
default RAM_SIZE_8M

config RAM_SIZE_64M
	bool "64M"

config RAM_SIZE_32M
	bool "32M"

config RAM_SIZE_16M
	bool "16M"

config RAM_SIZE_8M
	bool "8M"

config RAM_SIZE_4M
	bool "4M"
endchoice

endmenu
```

## rtk/boards/rtl8197f/config.in
```kconfig
menu "System Configuration"
 
config RTL_8197F
        bool "97F GW"
        help
          This enables support for Realtek RTL8197F demo board

choice
prompt "IC Name"
default RTL_8197FS

config RTL_8197FS
	bool "8197FS"

config RTL_8197FN
	bool "8197FN"

config RTL_8197FB
	bool "8197FB"
endchoice

config WATCHDOG
        bool "WatchDog Support"
 
config  MIPS16
        bool "Mips16 Support"

config ECOS_AP
	bool "pure ap mode"

choice
prompt "Selected RAM_SIZE"
default RAM_SIZE_16M

config RAM_SIZE_64M
	bool "64M"

config RAM_SIZE_32M
	bool "32M"

config RAM_SIZE_16M
	bool "16M"

config RAM_SIZE_8M
	bool "8M"
endchoice

endmenu
```

## rtk/boards/rtl8881a/config.in
```kconfig
menu "System Configuration"

config RTL_8881A
	bool "8881A GW"
	help
          This enables support for Realtek RTL8881A demo board

config WATCHDOG
        bool "WatchDog Support"
 
config  MIPS16
        bool "Mips16 Support"

config  RTL_8881AM
	bool "8881AM Support"
config RTL_XDG
	bool "realtek XDG"
config CUTE_MAHJONG
	bool "CUTE_MAHJONG"
config ECOS_AP
	depends on RTL_8881AM && !CUTE_MAHJONG && !RTL_XDG
	bool "pure ap mode"
choice 
prompt "Choose cute mahjong ui style"
default CUTE_MAHJONG_UI
depends on CUTE_MAHJONG

config CUTE_MAHJONG_UI
	bool "CUTE_MAHJONG_UI"

config CUTE_MAHJONG_RTK_UI
	bool "CUTE_MAHJONG_RTK_UI"
	select PPTP 
	select L2TP
	select PPPOE
	select MEM_CHAIN_API
	select MEM_CHAIN_UPGRADE
endchoice

choice
prompt "Selected RAM_SIZE"
default RAM_SIZE_16M
 
config RAM_SIZE_64M
        bool "64M"
 
config RAM_SIZE_32M
        bool "32M"
 
config RAM_SIZE_16M
        bool "16M"
 
config RAM_SIZE_8M
        bool "8M"
 
config RAM_SIZE_4M
        bool "4M"
 
endchoice

endmenu
```
